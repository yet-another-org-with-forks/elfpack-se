//(p) marry_on_me
-carm
//W900_R5BC004
-Z(CODE)START,CODE,DATA_C,INITTAB=21A70000-21A77FFF

-Z(CODE)PATCH_SWI=201372A4-201372AB
-Z(CODE)LIB=21A7C000-21A7FFFF

// change keyhandler
-Z(CODE)PATCH_KEYHANDLER1=204CEB4A-204CEB51
-Z(CODE)PATCH_KEYHANDLER2=204CF180-204CF187
-Z(CODE)PATCH_KEYHANDLER3=204CF304-204CF30B
-Z(CODE)PATCH_KEYHANDLER1_STACK1=204CEA70
-Z(CODE)PATCH_KEYHANDLER1_STACK2=204CEC1C
-Z(CODE)PATCH_KEYHANDLER1_CHANGE1=204CEB94
-Z(CODE)PATCH_KEYHANDLER1_CHANGE2=204CEBD0
-Z(CODE)PATCH_KEYHANDLER1_CHANGE3=204CEBE0
-Z(CODE)PATCH_KEYHANDLER1_CHANGE4=204CEC16

// static RAM
-Z(DATA)DATA_N=2824466C-2824466F // ???

// elf file association
-Z(CODE)PATCH_DB2=207B1590-207B1597
-Z(CODE)PATCH_DB1=207B16B0-207B16B7

// lists initialization
// initialization of KbdHookList, Helper, Daemons
-Z(CODE)PATCH_AUTO_RUN=2148B314-2148B317
-Z(CODE)PATCH_AUTO_RUN1=2148B318-2148B31B

//OseHook
-Z(CODE)PATCH_MMI_MESSAGE_HOOK=20D63A48-20D63A51

// PageActionHook
-Z(CODE)PATCH_PageActionImpl_All=2071766C-20717673
-Z(CODE)PATCH_PageActionImpl_EnterExit=20467414-2046741B

// TabMenuBar check
-Z(CODE)PATCH_TabMenuCheck=20B78604-20B7860B

//elfpackdata
-Z(CODE)EPD=28052928-2805292B // ???
